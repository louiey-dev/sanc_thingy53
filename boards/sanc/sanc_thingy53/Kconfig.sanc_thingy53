## boards/sanc/sanc_thingy53/Kconfig.sanc_thingy53
```kconfig
config BOARD_SANC_THINGY53
	select SOC_NRF5340_CPUAPP_QKAA if BOARD_SANC_THINGY53_NRF5340_CPUAPP || \
		BOARD_SANC_THINGY53_NRF5340_CPUAPP_NS
	select SOC_NRF5340_CPUNET_QKAA if BOARD_SANC_THINGY53_NRF5340_CPUNET
```

## boards/sanc/sanc_thingy53/Kconfig.sysbuild
```kconfig
if BOARD_SANC_THINGY53_NRF5340_CPUAPP || BOARD_SANC_THINGY53_NRF5340_CPUAPP_NS

choice BOOTLOADER
	default BOOTLOADER_MCUBOOT
endchoice

choice MCUBOOT_MODE
	default MCUBOOT_MODE_OVERWRITE_ONLY
endchoice

config SECURE_BOOT_NETCORE
	default y

config NETCORE_APP_UPDATE
	default y if SECURE_BOOT_NETCORE

config MCUBOOT_USE_ALL_AVAILABLE_RAM
	default y if BOARD_SANC_THINGY53_NRF5340_CPUAPP_NS && BOOTLOADER_MCUBOOT

endif # BOARD_SANC_THINGY53_NRF5340_CPUAPP || BOARD_SANC_THINGY53_NRF5340_CPUAPP_NS

config PM_EXTERNAL_FLASH_MCUBOOT_SECONDARY
	default y if BOOTLOADER_MCUBOOT

config PARTITION_MANAGER
	default y
```

## boards/sanc/sanc_thingy53/board.yml
```yaml
board:
  name: sanc_thingy53
  full_name: sanc_thingy53
  vendor: sanc
  socs:
  - name: nrf5340
    variants:
    - name: ns
      cpucluster: cpuapp
```
